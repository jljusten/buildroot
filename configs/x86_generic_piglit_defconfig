## configs/x86_generic_piglit_defconfig
```kconfig
BR2_x86_64=y
BR2_OPTIMIZE_2=y
BR2_TOOLCHAIN_BUILDROOT_GLIBC=y
BR2_TOOLCHAIN_BUILDROOT_CXX=y
BR2_ENABLE_LOCALE_PURGE=y
BR2_ENABLE_LOCALE_WHITELIST="C en_US"
BR2_GENERATE_LOCALE="en_US.UTF-8"
BR2_TARGET_GENERIC_HOSTNAME="piglit"
BR2_TARGET_GENERIC_ISSUE="Piglit Autorunner"
BR2_ROOTFS_DEVICE_CREATION_DYNAMIC_EUDEV=y
BR2_TARGET_TZ_INFO=y
BR2_TARGET_LOCALTIME="America/Los_Angeles"
BR2_ROOTFS_OVERLAY="board/x86/generic/fs-overlay/"
BR2_LINUX_KERNEL=y
BR2_LINUX_KERNEL_CUSTOM_GIT=y
BR2_LINUX_KERNEL_CUSTOM_REPO_URL="git://people.freedesktop.org/~bwidawsk/drm-intel"
BR2_LINUX_KERNEL_CUSTOM_REPO_VERSION="bdw-ppgtt"
BR2_LINUX_KERNEL_USE_CUSTOM_CONFIG=y
BR2_LINUX_KERNEL_CUSTOM_CONFIG_FILE="board/x86/generic/linux.config"
BR2_PACKAGE_BZIP2=y
BR2_PACKAGE_XZ=y
BR2_PACKAGE_PERF=y
BR2_PACKAGE_STRACE=y
BR2_PACKAGE_BINUTILS=y
BR2_PACKAGE_BINUTILS_TARGET=y
BR2_PACKAGE_GIT=y
BR2_PACKAGE_MAKE=y
BR2_PACKAGE_DOSFSTOOLS=y
BR2_PACKAGE_DOSFSTOOLS_FATLABEL=y
BR2_PACKAGE_DOSFSTOOLS_FSCK_FAT=y
BR2_PACKAGE_MESA3D=y
BR2_PACKAGE_MESA3D_DRI_DRIVER_I965=y
BR2_PACKAGE_MESA3D_OPENGL_EGL=y
BR2_PACKAGE_MESA3D_OPENGL_GBM=y
BR2_PACKAGE_PIGLIT=y
BR2_PACKAGE_XORG7=y
BR2_PACKAGE_XSERVER_XORG_SERVER=y
BR2_PACKAGE_XSERVER_XORG_SERVER_MODULAR=y
BR2_PACKAGE_XDRIVER_XF86_VIDEO_INTEL=y
BR2_PACKAGE_XPROTO_DRI3PROTO=y
BR2_PACKAGE_EUDEV_RULES_GEN=y
BR2_PACKAGE_PYTHON=y
BR2_PACKAGE_PYTHON_PY_ONLY=y
BR2_PACKAGE_PYTHON_MAKO=y
BR2_PACKAGE_PYTHON_NUMPY=y
BR2_PACKAGE_GNUTLS=y
BR2_PACKAGE_GNUTLS_TOOLS=y
BR2_PACKAGE_OPENSSL=y
BR2_PACKAGE_CAIRO=y
BR2_PACKAGE_CAIRO_PNG=y
BR2_PACKAGE_JPEG=y
BR2_PACKAGE_JPEG_TURBO=y
BR2_PACKAGE_LIBDRM_INSTALL_TESTS=y
BR2_PACKAGE_WAYLAND=y
BR2_PACKAGE_LIBXKBCOMMON=y
BR2_PACKAGE_MTDEV=y
BR2_PACKAGE_READLINE=y
BR2_PACKAGE_AVAHI=y
BR2_PACKAGE_AVAHI_DAEMON=y
BR2_PACKAGE_DHCPCD=y
BR2_PACKAGE_DROPBEAR=y
# BR2_PACKAGE_DROPBEAR_SMALL is not set
BR2_PACKAGE_RSYNC=y
BR2_PACKAGE_WIRELESS_TOOLS=y
BR2_PACKAGE_WIRELESS_TOOLS_LIB=y
BR2_PACKAGE_FILE=y
BR2_PACKAGE_TMUX=y
BR2_PACKAGE_ACL=y
BR2_TARGET_ROOTFS_INITRAMFS=y
BR2_PACKAGE_INTEL_GPU_TOOLS=y
```

## package/glu/Config.in
```kconfig
menuconfig BR2_PACKAGE_GLU
	bool "glu"
	depends on BR2_PACKAGE_MESA3D
	help
	  The OpenGL Utility Library

	  http://cgit.freedesktop.org/mesa/glu/
```

## package/intel-gpu-tools/Config.in
```kconfig
config BR2_PACKAGE_INTEL_GPU_TOOLS
	bool "intel-gpu-tools"

	select BR2_PACKAGE_CAIRO
	select BR2_PACKAGE_LIBDRM_INTEL
	select BR2_PACKAGE_HAS_UDEV
	select BR2_PACKAGE_XLIB_LIBPCIACCESS
	select BR2_PACKAGE_XLIB_LIBXEXT
	select BR2_PACKAGE_XLIB_LIBXRANDR
	select BR2_PACKAGE_XDRIVER_XF86_VIDEO_INTEL
	select BR2_PACKAGE_LIBGLIB2

	help
	  tools for debugging the Intel graphics driver
	  intel-gpu-tools is a package of tools for debugging the Intel graphics driver,
 	  including a GPU hang dumping program, performance monitor, and performance
 	  microbenchmarks for regression testing the DRM.

	  https://01.org/linuxgraphics/
```

## package/piglit/Config.in
```kconfig
config BR2_PACKAGE_PIGLIT
	bool "piglit"
	# Mako and Numpy are both build deps only
	depends on BR2_PACKAGE_PYTHON_MAKO
	depends on BR2_PACKAGE_PYTHON_NUMPY

	# Everything else is both runtime + build dep.
	depends on BR2_PACKAGE_PYTHON
	select BR2_PACKAGE_WAFFLE
	select BR2_PACKAGE_GLU
	# We could be explicit on our GL deps, but *any* mesa build should give us what we want.
	# depends on (BR2_PACKAGE_HAS_LIBGL || BR2_PACKAGE_HAS_LIBGBM || BR2_PACKAGE_HAS_LIBEGL || BR2_PACKAGE_HAS_LIBGLES)
	depends on BR2_PACKAGE_MESA3D
	help
	  Piglit is an open-source test suite for OpenGL implementations.

	  http://piglit.freedesktop.org/
```

## package/python-mako/Config.in
```kconfig
config BR2_PACKAGE_PYTHON_MAKO
	bool "python-mako"
	depends on BR2_PACKAGE_PYTHON
	help
	  A super-fast templating language that borrows the best ideas from the
	  existing templating languages

	  http://www.makotemplates.org/
```

## package/waffle/Config.in
```kconfig
config BR2_PACKAGE_WAFFLE
	bool "waffle"
	# egl covers GBM, wayland covers wayland, X GLX
	depends on BR2_PACKAGE_HAS_LIBEGL || BR2_PACKAGE_WAYLAND || BR2_PACKAGE_XSERVER_XORG_SERVER
	help
	  Waffle is a cross-platform C library that allows one to defer
	  selection of an OpenGL API and window system until runtime. For
	  example, on Linux, Waffle enables an application to select X11/EGL
	  with an OpenGL 3.3 core profile, Wayland with OpenGL ES2, and other
	  window system / API combinations.

	  http://www.waffle-gl.org/
```
